## dts/bindings/gpio/nuvoton,npcm4xx-sgpio.yaml
```yaml
# Copyright (c) 2023 Nuvoton Technology Corporation.
# SPDX-License-Identifier: Apache-2.0


description: Nuvoton, NPCM4XX-SGPIO node

compatible: "nuvoton,npcm4xx-sgpio"

include: [base.yaml, nuvoton-pinctrl.yaml]

properties:
  reg:
    required: true

  label:
    required: true

  nuvoton,bus-freq:
    type: int
    default: 8000000
    description:
      SGPIO clock frequency.

  nuvoton,input-ngpios:
    type: int
    required: true

  nuvoton,output-ngpios:
    type: int
    required: true

child-binding:
  description: GPIO child node
  include: gpio-controller.yaml
  properties:
    label:
      type: string
      required: true

    ngpios:
      required: true

    pin-offset:
      type: int
      required: true
      description: Pin offset of this GPIO entry

    "#gpio-cells":
      const: 2

  gpio-cells:
  - pin
  - flags
```

## dts/bindings/i2c/nuvoton,npcm4xx-i2c.yaml
```yaml
# Copyright (c) 2020 Nuvoton Technology Corporation.
# SPDX-License-Identifier: Apache-2.0

description: Nuvoton, NPCM4XX-I2C controller node

compatible: "nuvoton,npcm4xx-i2c"

include: ["base.yaml", "nuvoton-pinctrl.yaml", "i2c-controller.yaml"]

properties:
    reg:
        required: true
    clocks:
        required: true
    label:
        required: true
```

## dts/bindings/i2c/zephyr,i2c-ipmb.yaml
```yaml
#
# Copyright (c) ZEPHYR
#
# SPDX-License-Identifier: Apache-2.0
#

description: ZEPHYR I2C IPMB device

compatible: "zephyr,i2c-ipmb"

include: i2c-device.yaml

properties:
    size:
      type: int
      required: true
      description: Total IPMB page size
```

## dts/bindings/i3c/i3c-controller.yaml
```yaml
# Copyright (c) 2023 Zephyr Inc.
# SPDX-License-Identifier: Apache-2.0

# Common fields for I3C devices

# Copyright (c) 2023 Nuvoton Technology Corporation.
# SPDX-License-Identifier: Apache-2.0

include: base.yaml

bus: i3c

properties:
    label:
      required: true
    i2c-scl-hz:
      required: false
      type: int
      default: 1000000
      description: I2C mode and Open-drain mode SCL frequency in HZ
    i3c-scl-hz:
      required: false
      type: int
      default: 12500000
      description: I3C Push-Pull mode SCL frequency in HZ
```

## dts/bindings/i3c/nuvoton,npcm4xx-i3c.yaml
```yaml
# Copyright (c) 2023 Nuvoton Technology Corporation.
# SPDX-License-Identifier: Apache-2.0

description: NUVOTON I3C

compatible: "nuvoton,npcm4xx-i3c"

include: [i3c-controller.yaml, nuvoton-pinctrl.yaml]

properties:
# specify port number
  instance-id:
    required: true
    type: int
    description: Instance ID of the device

#specify port address (master: dynamic address, slave: assigned address for ENTDAA or static address for SETAASA and SETDASA)
  assigned-address:
    required: true
    type: int
    description: |
      Dynamic address when playing the role as the main master. Static address when playing the role as the slave.
      If extra-gpios exist, the lsb of slave static address will be replaced by the value of extra-gpios.

# not declare --> master
# declare --> slave
  slave:
    required: false
    type: boolean
    description: Initialized as slave / master

# declare --> secondary master if slave is config
  secondary:
    required: false
    type: boolean
    description: Initialized as a secondary master

  manufacture-id:
    required: false
    type: int
    description: PID[47:32]

  part-id:
    required: false
    type: int
    description: PID[31:16]

  vendor-def-id:
    required: false
    type: int
    description: PID[11:0]

  bcr:
    required: false
    type: int
    description: Bus Characteristics Register

  dcr:
    required: false
    type: int
    description: Device Characteristics Register

  busno:
    required: false
    type: int
    description: Bus Number

# pinctrl
  pinctrl-0:
    required: true

  extra-gpios:
      type: phandle-array
      required: false
      description: |
        Used to add the extra info to identify different BIC by GPIOs.

  ibi-append-pec:
    required: false
    type: boolean
    description: Append PEC byte to the IBI data.  Enable this option in slave mode if the master device is AST2600 or AST1030A0.

  priv-xfer-pec:
    required: false
    type: boolean
    description: |
      Enable this option in slave mode if the i3c want to communicate with data that have PEC.
      The PEC will auto append to the tail of the data when doing private transfer and verify
      the PEC when receiving the data from master.

  pid-extra-info:
    required: false
    type: int
    description: |
      Extra information of the PID Bits[11:0]. Use to identify the different BIC.
      If extra-gpios exist, the extra pid will be replaced by the value of extra-gpios.

  sda-tx-hold-ns:
    required: false
    type: int
    description: The hold time of the SDA with respect to the SCL edge. The unit is in nanosecond.
```

## dts/bindings/interrupt-controller/nuvoton,npcm4xx-miwu-wui-map.yaml
```yaml
# Copyright (c) 2020 Nuvoton Technology Corporation.
# SPDX-License-Identifier: Apache-2.0

description: NPCM4XX-MIWU Wake-Up Unit Input (WUI) mapping child node

compatible: "nuvoton,npcm4xx-miwu-wui-map"

child-binding:
    description: Child node to present the mapping between input of MIWU and its source device
    properties:
       miwus:
            type: phandle-array
            required: true
```

## dts/bindings/ipmi/ipmi-controller.yaml
```yaml
# Copyright (c) 2021 Nuvoton Technology Corporation.
# SPDX-License-Identifier: Apache-2.0

# Common fields for IPMI devices

include: base.yaml

properties:
    label:
      required: true
```

## dts/bindings/ipmi/nuvoton,npcm4xx-kcs.yaml
```yaml
# Copyright (c) 2021, Nuvoton Technology Corporation.
# SPDX-License-Identifier: Apache-2.0

description: Nuvoton NPCM4XX IPMI KCS

compatible: "nuvoton,npcm4xx-kcs"

include: ipmi-controller.yaml

properties:
    chan:
      type: int
      required: true
      description: KCS channel number

    addr:
      type: int
      required: true
      description: KCS I/O port address
```

## dts/bindings/peci/nuvoton,npcm4xx-peci.yaml
```yaml
# Copyright (c) 2022 Nuvoton Technology Corporation.
# SPDX-License-Identifier: Apache-2.0

description: Nuvoton NPCM4XX PECI node

compatible: "nuvoton,npcm4xx-peci"

include: [peci.yaml, nuvoton-pinctrl.yaml]

properties:
  pinctrl-0:
    required: true
```

## dts/bindings/pinctrl/nuvoton,npcm4xx-pinmux.yaml
```yaml
description: Nuvoton Pinmux

compatible: "nuvoton,npcm4xx-pinmux"

include: base.yaml
```

## dts/bindings/pinctrl/nuvoton-pinctrl.yaml
```yaml
# Copyright (c) 2023, Nuvoton
# SPDX-License-Identifier: Apache-2.0
# Common fields for Nuvoton pinctrl
properties:
  pinctrl-0:
    type: phandles
    description: |
      We expect that the phandles will reference pinctrl nodes in
      npcm4xx-pinctrl.dtsi.
```

## dts/bindings/serial/nuvoton,nct6694b-uart.yaml
```yaml
description: NUVOTON NCT6694 FAMILY UART

compatible: "nuvoton,nct6694b-uart"

include: uart-controller.yaml

properties:
    reg:
      required: true
```

## dts/bindings/serial/nuvoton,npcm4xx-uart.yaml
```yaml
description: NUVOTON NPCM4XX FAMILY UART

compatible: "nuvoton,npcm4xx-uart"

include: ["uart-controller.yaml", "nuvoton-pinctrl.yaml"]

properties:
    reg:
        required: true
    clocks:
        required: true
```

## dts/bindings/spi/nuvoton,npcm4xx-spi-fiu.yaml
```yaml
# Copyright (c) 2023 Nuvoton Technology Corporation.
# SPDX-License-Identifier: Apache-2.0

description: Nuvoton, NPCM4XX-SPI-FIU controller node

compatible: "nuvoton,npcm4xx-spi-fiu"

include: ["spi-controller.yaml", "nuvoton-pinctrl.yaml"]

properties:
  reg:
    required: true
  clocks:
    required: true
  ctrl-type:
    type: string
    required: true
    description: |
      Distinguish the controller auxiliary type.

      There are two types for a Nuvoton controller:
      host(master/host) SPI flash controller (hspi),
      and normal(slave/core) SPI flash controller (nspi).

    enum:
      - "hspi"
      - "nspi"

  spi-ctrl-caps-mask:
    type: int
    required: false
    description: |
      SPI flash controller mode/protocol capability configuration.

      bit 0 : disable 1-1-1
      bit 1 : disable 1-1-1 (fast read)
      bit 8 : disable 1-1-2
      bit 9 : disable 1-2-2
      bit 10: disable 2-2-2
      bit 16: disable 1-1-4
      bit 17: disable 1-4-4
      bit 18: disable 4-4-4
```

## dts/bindings/spi/nuvoton,npcm4xx-spip.yaml
```yaml
# Copyright (c) 2023 Nuvoton Technology Corporation.
# SPDX-License-Identifier: Apache-2.0

description: Nuvoton, NPCM4XX-SPIP controller node

compatible: "nuvoton,npcm4xx-spip"

include: ["spi-controller.yaml", "nuvoton-pinctrl.yaml"]

properties:
  reg:
    required: true
  clocks:
    required: true
```

## dts/bindings/timer/nuvoton,npcm4xx-itim-timer.yaml
```yaml
# Copyright (c) 2021 Nuvoton Technology Corporation.
# SPDX-License-Identifier: Apache-2.0

description: Nuvoton, NPCM4XX Internal Timer (ITIM) node

compatible: "nuvoton,npcm4xx-itim-timer"

include: base.yaml

properties:
    reg:
        required: true

    interrupts:
        required: true

    label:
        required: true
```

## dts/bindings/usb/nuvoton,npcm4xx-usbd.yaml
```yaml
# Copyright (c) 2023 Nuvoton Technology Corporation.
# SPDX-License-Identifier: Apache-2.0

description: |
    Nuvoton, NPCM4XX-USBD node

compatible: "nuvoton,npcm4xx-usbd"

include: [usb-ep.yaml, nuvoton-pinctrl.yaml]

properties:
    reg:
      required: true

    interrupts:
      required: true

    usbd-ram-size:
      type: int
      required: true
      description: Configurable RAM used as endpoint buffer (including EP0)
```

## dts/bindings/watchdog/nuvoton,npcm4xx-watchdog.yaml
```yaml
# Copyright (c) 2023 Nuvoton Technology Corporation.
# SPDX-License-Identifier: Apache-2.0

description: Nuvoton, NPCM4XX-TWD node

compatible: "nuvoton,npcm4xx-watchdog"

include: [base.yaml]

properties:
    reg:
        required: true
    label:
        required: true
    interrupts:
        required: true
```

## soc/arm/npcm4xx/Kconfig
```kconfig
# Nuvoton NPCM4XX Cortex-M4

# Copyright (c) 2021 Nuvoton Technology Corporation.
# SPDX-License-Identifier: Apache-2.0

config SOC_FAMILY_NPCM4XX
	select PLATFORM_SPECIFIC_INIT
	bool

if SOC_FAMILY_NPCM4XX
config SOC_FAMILY
	string
	default "npcm4xx"

# Select SoC Part No. and configuration options
source "soc/arm/npcm4xx/*/Kconfig.soc"

endif # SOC_FAMILY_NPCM4XX
```

## soc/arm/npcm4xx/Kconfig.soc
```kconfig
# Nuvoton NPCM4XX Cortex-M4

# Copyright (c) 2021 Nuvoton Technology Corporation.
# SPDX-License-Identifier: Apache-2.0

source "soc/arm/npcm4xx/*/Kconfig.series"
```

## soc/arm/npcm4xx/npcm400f/Kconfig.defconfig.npcm400f
```kconfig
# Nuvoton NPCM400F Cortex-M4

# Copyright (c) 2021 Nuvoton Technology Corporation.
# SPDX-License-Identifier: Apache-2.0

if SOC_NPCM400F

config SOC
	default "npcm400f"

endif # SOC_NPCM400F
```

## soc/arm/npcm4xx/npcm400f/Kconfig.defconfig.series
```kconfig
# Nuvoton NPCM400F Cortex-M4

# Copyright (c) 2021 Nuvoton Technology Corporation.
# SPDX-License-Identifier: Apache-2.0

if SOC_SERIES_NPCM400F

config SOC_SERIES
	default "npcm400f"

config NUM_IRQS
	default 82

config ESPI_NPCM4XX
	default y
	depends on ESPI
	help
	  Enable support for NPCM4XX ESPI driver. The Intel Enhanced Serial
	  Peripheral Interface (eSPI) provides a path for migrating host
	  sub-devices via LPC to a lower pin count, higher bandwidth bus.
	  So far, this driver supports all of functionalities beside flash
	  channel support. It will be supported in the future. Please refer
	  https://www.intel.com/content/www/us/en/support/articles/000020952/
	  software/chipset-software.html for more detail.

choice GPIO_NPCM4XX_RESET_SL
	prompt "Selects the GPIO reset to the corresponding reset source"
	default GPIO_NPCM4XX_RESET_SL_CORE_DOMAIN

config GPIO_NPCM4XX_RESET_SL_CORE_DOMAIN
	bool "GPIO Reset by Core domain reset"
	help
	  GPIO port 0-9, A-F is reset by Core domain reset.

config GPIO_NPCM4XX_RESET_SL_POWER_UP
	bool "GPIO Reset by VSB Power-Up reset"
	help
	GPIO port 0-9, A-F is reset by VSB Power-Up reset.
endchoice

DT_CHOSEN_Z_FLASH := zephyr,flash

config FLASH_SIZE
	int "Flash Size in kB"
	default $(dt_chosen_reg_size_int,$(DT_CHOSEN_Z_FLASH),0,K) if !XIP
	help
	  This option specifies the size of the flash in kB.  It is normally set by
	  the board's defconfig file and the user should generally avoid modifying
	  it via the menu configuration.

config FLASH_BASE_ADDRESS
	hex "Flash Base Address"
	default $(dt_chosen_reg_addr_hex,$(DT_CHOSEN_Z_FLASH)) if !XIP
	help
	  This option specifies the base address of the flash on the board. It is
	  normally set by the board's defconfig file and the user should generally
	  avoid modifying it via the menu configuration.

source "soc/arm/npcm4xx/npcm400f/Kconfig.defconfig.npcm400f*"

endif # SOC_SERIES_NPCM400F
```

## soc/arm/npcm4xx/npcm400f/Kconfig.series
```kconfig
# Nuvoton NPCM400F Cortex-M4

# Copyright (c) 2021 Nuvoton Technology Corporation.
# SPDX-License-Identifier: Apache-2.0

config SOC_SERIES_NPCM400F
	bool "Nuvoton NPCM400F Series"
	select ARM
	select CPU_CORTEX_M4
	select CPU_CORTEX_M_HAS_DWT
	select SOC_FAMILY_NPCM4XX
	select CORTEX_M_SYSTICK
	help
	  Enable support for Nuvoton NPCM400F series
```

## soc/arm/npcm4xx/npcm400f/Kconfig.soc
```kconfig
# Nuvoton NPCM400F Cortex-M4

# Copyright (c) 2021 Nuvoton Technology Corporation.
# SPDX-License-Identifier: Apache-2.0

choice
	prompt "NPCM400F Selection"
	depends on SOC_SERIES_NPCM400F

config SOC_NPCM400F
	bool "npcm400f"

endchoice
```

## soc/arm64/nuvoton_npcm8xx/Kconfig.defconfig
```kconfig
# Copyright 2023 Nuvoton
# SPDX-License-Identifier: Apache-2.0

if SOC_NUVOTON_NPCM8XX

config SOC
	default "nuvoton_npcm8xx"

config NUM_IRQS
	int
	default 256

config SYS_CLOCK_HW_CYCLES_PER_SEC
	int
	default 1000000000

endif
```

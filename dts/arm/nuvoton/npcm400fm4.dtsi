/*
 * Copyright (c) 2021 Nuvoton Technology Corporation.
 *
 * SPDX-License-Identifier: Apache-2.0
 */

#include <mem.h>
#include "npcm400f.dtsi"

/ {
	flash0: flash@80000 {
		reg = <0x00080000 DT_SIZE_M(1)>;
	};

	sram0: memory@10008000 {
		compatible = "mmio-sram";
		reg = <0x10008000 DT_SIZE_K(764)>;
	};

	soc-id {
		device-id = <0x21>;
	};
};

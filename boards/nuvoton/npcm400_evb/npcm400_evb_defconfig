## boards/nuvoton/npcm400_evb/npcm400_evb_defconfig
```kconfig
# Copyright (c) 2024 Nuvoton Technology Corporation.
#
# SPDX-License-Identifier: Apache-2.0

CONFIG_SRAM_VECTOR_TABLE=y

# General Kernel Options
CONFIG_SYS_CLOCK_HW_CYCLES_PER_SEC=96000000
CONFIG_XIP=y

# GPIO Driver
CONFIG_GPIO=y

# UART Driver
CONFIG_SERIAL=y
CONFIG_UART_INTERRUPT_DRIVEN=y

# Console Driver
CONFIG_CONSOLE=y
CONFIG_UART_CONSOLE=y

# Flash Driver
CONFIG_FLASH=y
CONFIG_FLASH_SHELL=y

# Watchdog Driver
CONFIG_WATCHDOG=y

# ADC Driver
CONFIG_ADC=y

# I2C Driver
CONFIG_I2C=y

# C2H Driver
CONFIG_C2H_NPCM=y

#I3C Driver
CONFIG_I3C=y
CONFIG_I3C_USE_IBI=y
CONFIG_I3C_SHELL=y
```

## boards/nuvoton/npcm500_evb/Kconfig.npcm500_evb
```kconfig
# Copyright (c) 2026 Nuvoton Technology Corporation.
# SPDX-License-Identifier: Apache-2.0

config BOARD_NPCM500_EVB
	select SOC_NPCM500
```

## boards/nuvoton/npcm500_evb/board.yml
```yaml
board:
  name: npcm500_evb
  full_name: NPCM500_EVB
  vendor: nuvoton
  socs:
  - name: npcm500
```

## drivers/flash/Kconfig.npcx_spim
```kconfig
# NPCX SPIM Flash driver configuration options

# Copyright (c) 2024 Nuvoton Technology Corporation.
# SPDX-License-Identifier: Apache-2.0

config FLASH_NPCX_SPIM_QSPI
	bool "Nuvoton NPCX SPIM QSPI Bus Flash driver"
	default y
	depends on DT_HAS_NUVOTON_NPCX_SPIM_QSPI_ENABLED
	help
	  This option enables the SPIM QSPI Bus Flash driver for NPCX family
	  of processors.

config FLASH_NPCX_SPIM_NOR
	bool "Nuvoton NPCX embedded controller (EC) QSPI NOR Flash driver"
	default y
	depends on DT_HAS_NUVOTON_NPCX_SPIM_NOR_ENABLED
	depends on FLASH_NPCX_SPIM_QSPI
	select FLASH_HAS_DRIVER_ENABLED
	select FLASH_HAS_PAGE_LAYOUT
	select FLASH_HAS_EXPLICIT_ERASE
	select FLASH_JESD216
	select FLASH_HAS_EX_OP
	help
	  This option enables the QSPI NOR Flash driver for NPCX family of
	  processors.

if FLASH_NPCX_SPIM_QSPI

config FLASH_NPCX_SPIM_NOR_INIT
	bool "QSPI NOR flash feature during driver initialization"
	default y
	depends on FLASH_NPCX_SPIM_NOR
	help
	  This option enables the QSPI NOR Flash features such as Quad-Enable,
	  4-byte address support and so on during driver initialization. Disable
	  it if QSPI NOR devices are not ready during driver initialization.

config FLASH_NPCX_SPIM_SUPP_DRA_4B_ADDR
	bool "4 byte address support in Direct Read Access mode"
	default y
	help
	  Selected if NPCX series supports 4 byte address mode in Direct Read
	  Access mode.

endif # FLASH_NPCX_SPIM_QSPI
```

## drivers/gpio/Kconfig.npcm
```kconfig
# NPCM GPIO driver configuration options

# Copyright (c) 2024 Nuvoton Technology Corporation.
# SPDX-License-Identifier: Apache-2.0

config GPIO_NPCM
	bool "Nuvoton NPCM GPIO driver"
	default y
	depends on DT_HAS_NUVOTON_NPCM_GPIO_ENABLED
	select PINCTRL if $(dt_compat_any_has_prop,$(DT_COMPAT_NUVOTON_NPCM_GPIO),pinctrl-0)
	help
	  This option enables the GPIO driver for the NPCM family of
	  processors. Each port owns one Multi-Input Wake-Up (MIWU) input
	  group, which provides its pin interrupts.
```

## drivers/gpio/Kconfig.npcm4xx_vw
```kconfig
# NPCM4XX Virtual Wire GPIO driver configuration options

# Copyright (c) 2023 Nuvoton Technology Corporation.
# SPDX-License-Identifier: Apache-2.0

config GPIO_NPCM4XX_VW
	bool "Nuvoton NPCM4XX eSPI Virtual Wire GPIO driver"
	depends on SOC_FAMILY_NPCM4XX
	depends on ESPI
	help
	  This option enables the eSPI Virtual Wire GPIO driver for
	  NPCM4XX family of processors. Virtual Wire GPIOs are mapped
	  through the eSPI virtual wire channel (VWGPSM/VWGPMS registers).
	  Say y if you wish to use Virtual Wire GPIO on NPCM4XX MCU.

config GPIO_NPCM4XX_VW_INIT_PRIORITY
	int "NPCM4XX Virtual Wire GPIO init priority"
	depends on GPIO_NPCM4XX_VW
	default 61
	help
	  Device driver initialization priority for Virtual Wire GPIO.
	  Must be initialized after eSPI controller.
```

## drivers/i2c/Kconfig.npcm
```kconfig
# NPCM I2C driver configuration options

# Copyright (c) 2024 Nuvoton Technology Corporation.
# SPDX-License-Identifier: Apache-2.0

config I2C_NPCM
	bool "Nuvoton NPCM I2C driver"
	default y
	depends on DT_HAS_NUVOTON_NPCM_I2C_ENABLED
	select PINCTRL
	help
	  This option enables the I2C driver for NPCM family of
	  processors.
	  Say y to use I2C modules on NPCM MCU.

config I2C_NPCM_CONTROLLER_HW_TIMEOUT_EN
	bool "Enable hardware timeout for NPCM I2C controller"
	default n
	depends on I2C_NPCM
	help
	  This option enables hardware timeout feature for NPCM I2C
	  controller. When enabled, the controller will stop the
	  transaction when the timeout expires.

config I2C_NPCM_CONTROLLER_HW_TIMEOUT_CLK_CYCLE_TIME
	depends on I2C_NPCM_CONTROLLER_HW_TIMEOUT_EN
	int "NPCM I2C controller timeout clock cycle time [ms]"
	default 50
	help
	  This option sets the clock cycle time for the hardware timeout
	  feature for NPCM I2C controller. The unit is in milliseconds.

config I2C_NPCM_CONTROLLER_HW_TIMEOUT_CLK_LOW_TIME
	depends on I2C_NPCM_CONTROLLER_HW_TIMEOUT_EN
	int "NPCM I2C controller timeout clock low extend time [ms]"
	default 25
	help
	  This option sets the clock low extend time for the hardware timeout
	  feature for NPCM I2C controller. The unit is in milliseconds.

config I2C_NPCM_TARGET_HW_TIMEOUT_EN
	bool "Enable hardware timeout for NPCM I2C target"
	default n
	depends on I2C_NPCM
	help
	  This option enables hardware timeout feature for NPCM I2C
	  target. When enabled, the target will stop the transaction
	  when the timeout expires. When using Quick command (SMBUS),
	  do not enable target timeout.

config I2C_NPCM_TARGET_HW_TIMEOUT_CLK_CYCLE_TIME
	depends on I2C_NPCM_TARGET_HW_TIMEOUT_EN
	int "NPCM I2C target timeout clock cycle time [ms]"
	default 50
	help
	  This option sets the clock cycle time for the hardware timeout
	  feature for NPCM I2C target. The unit is in milliseconds.

config I2C_NPCM_TARGET_HW_TIMEOUT_CLK_LOW_TIME
	depends on I2C_NPCM_TARGET_HW_TIMEOUT_EN
	int "NPCM I2C target timeout clock low extend time [ms]"
	default 25
	help
	  This option sets the clock low extend time for the hardware timeout
	  feature for NPCM I2C target. The unit is in milliseconds.
```

## drivers/interrupt_controller/Kconfig.npcm
```kconfig
# NPCM MIWU driver configuration options

# Copyright (c) 2024 Nuvoton Technology Corporation.
# SPDX-License-Identifier: Apache-2.0

config NPCM_MIWU
	bool "Nuvoton NPCM Multi-Input Wake-Up (MIWU) driver"
	default y
	depends on DT_HAS_NUVOTON_NPCM_MIWU_ENABLED
	help
	  This option enables the MIWU driver for the NPCM family of
	  processors. It services the wake-up input groups shared by several
	  peripherals, such as SMBus, RTC, and eSPI virtual wires, and
	  dispatches their interrupts to the owning drivers. GPIO ports
	  program their own groups and do not need this driver.
```

## drivers/misc/c2h_npcm/Kconfig
```kconfig
# NPCM misc. driver options

# Copyright (c) 2024 Nuvoton
# SPDX-License-Identifier: Apache-2.0


config C2H_NPCM
	bool "NPCM core access to host modules driver"
	depends on DT_HAS_NUVOTON_NPCM_C2H_ENABLED
	help
	  This option enables the c2h driver for NPCM
	  SoCs.
	  Say y if you wish to access host modules
	  on NPCM SMC.

if C2H_NPCM
module = C2H_NPCM
module-str = c2h_npcm
source "subsys/logging/Kconfig.template.log_config"
endif
```

## drivers/pinctrl/Kconfig.npcm
```kconfig
# NPCM Pin Controller configuration options

# Copyright (c) 2024 Nuvoton Technology Corporation.
# SPDX-License-Identifier: Apache-2.0


config PINCTRL_NPCM
	bool "Nuvoton NPCM enhanced Super I/O (eSIO) pin controller driver"
	default y
	depends on DT_HAS_NUVOTON_NPCM_PINCTRL_ENABLED
	help
		This option enables the pin controller driver for NPCM family of
		processors.

config PINCTRL_NPCM_CFG_ON_RESET_CAUSE
	bool "Enable pin configuration on reset cause"
	default y
	depends on PINCTRL_NPCM
	depends on HWINFO_HAS_DRIVER
	help
		This option enables the pin configuration on reset cause.
		When the system is reset, the pin controller will configure the
		pins according to the reset cause. This is useful for ensuring
		that the pins are configured correctly after a reset.
```

## drivers/sensor/nuvoton_tach_npcm/Kconfig
```kconfig
# NPCM tachometer sensor configuration options

# Copyright (c) 2025 Nuvoton Technology Corporation.
# SPDX-License-Identifier: Apache-2.0

config TACH_NPCM
	bool "Nuvoton NPCM Tachometer sensor"
	default y
	depends on SOC_FAMILY_NPCM4XX
	help
	  Enable the "Nuvoton NPCM tachometer sensor.
```

## dts/bindings/adc/nuvoton,npcm-adc.yaml
```yaml
# Copyright (c) 2024 Nuvoton Technology Corporation.
# SPDX-License-Identifier: Apache-2.0

description: Nuvoton, NPCM-ADC node

compatible: "nuvoton,npcm-adc"

include: [adc-controller.yaml, pinctrl-device.yaml]

properties:
  reg:
    required: true
  clocks:
    required: true
  pinctrl-0:
    required: true
  pinctrl-names:
    required: true
  nuvoton,channel-count:
    type: int
    required: true
    description: The number of ADC channels.
  nuvoton,channel-cfg:
    type: array
    required: true
    description: |
      The configuration of each ADC channel. The array length should be equal to
      the number of channels.

io-channel-cells:
  - input
```

## dts/bindings/flash_controller/nuvoton,npcx-spim-qspi.yaml
```yaml
# Copyright (c) 2024 Nuvoton Technology Corporation.
# SPDX-License-Identifier: Apache-2.0

description: |
    Properties defining the NPCX Quad-SPI peripheral of Synchronous serial Interface Controller (SPIM).
    A npcx quad-spim-spi dt node would typically looks like:

        &qspi_spim0 {
            status = "okay";

            int_flash: w25q400@0 {
                status = "okay";
                reg = <0>;
                ...
            };

            ext_flash: w25q256@1 {
                status = "okay";
                reg = <1>;
                ...
            };
        };

    `int_flash` and `ext_flash` are the devices accessed by this peripheral.

compatible: "nuvoton,npcx-spim-qspi"

include: [base.yaml, pinctrl-device.yaml]

bus: qspi

properties:
  reg:
    required: true
  clocks:
    required: true
```

## dts/bindings/gpio/nuvoton,npcm-gpio.yaml
```yaml
# Copyright (c) 2024 Nuvoton Technology Corporation.
# SPDX-License-Identifier: Apache-2.0

description: |
  Nuvoton NPCM GPIO port.

  Each node represents an 8-bit port and its direction, level, pull-resistor, and output-type
  registers. GPIO interrupts are routed through one Multi-Input Wake-Up (MIWU) group. The
  group's eight inputs correspond to the port's pins and it has a dedicated NVIC line. The
  driver programs the group directly, so a separate MIWU driver is not required.

  This binding does not configure pin multiplexing. To reclaim a pin whose reset function is
  not GPIO, reference its pin_gpioNN_gpio function from a pin group and assign that group to
  this node's pinctrl-0 property. The driver applies the state during initialization.

  Example, port 6 with GPIO62 and GPIO65 reclaimed from RSTOUT0 and SLP_S5:

    &pinctrl {
      gpio62_65_gpio: gpio62-65-gpio {
        g62 { pinmux = <&pin_gpio62_gpio>; };
        g65 { pinmux = <&pin_gpio65_gpio>; };
      };
    };

    &gpio6 {
      pinctrl-0 = <&gpio62_65_gpio>;
      pinctrl-names = "default";
    };

  Pull resistors on output pins take effect only in open-drain mode. The driver enables
  GPIO_OUT_PULLEN in SCFG during initialization so GPIO_PULL_UP with GPIO_OPEN_DRAIN works
  as defined by the GPIO API.

compatible: "nuvoton,npcm-gpio"

include: [gpio-controller.yaml, pinctrl-device.yaml, base.yaml]

properties:
  reg:
    required: true

  interrupts:
    required: true
    description: NVIC line assigned to the port's MIWU input group.

  nuvoton,miwu:
    type: phandle
    required: true
    description: MIWU module containing the port's input group.

  nuvoton,wui-group:
    type: int
    required: true
    enum: [1, 2, 3, 4, 5, 6, 7, 8]
    description: Port input group in the MIWU module, using the datasheet numbering.

  nuvoton,scfg:
    type: phandle
    required: true
    description: System Configuration block that holds GPIO_OUT_PULLEN.

  "#gpio-cells":
    const: 2

gpio-cells:
  - pin
  - flags
```

## dts/bindings/gpio/nuvoton,npcm4xx-vw-gpio.yaml
```yaml
# Copyright (c) 2023 Nuvoton Technology Corporation.
# SPDX-License-Identifier: Apache-2.0

description: |
  Nuvoton NPCM4XX eSPI Virtual Wire GPIO controller.

  This node is the parent controller covering the full VW GPIO register range.
  Child nodes (no compatible needed) each represent one 32-bit bank register
  controlling 4 wires:
    Bits [3:0]  = Wire 3-0 data
    Bits [7:4]  = Wire 3-0 Valid (set when writing to VWGPSM)

  Register address is computed by the driver as:
    parent_base + (is_output ? 0 : 0x40) + bank_idx * 4

  VWGPSM (Slave-to-Master, output, BIC->Host): set nuvoton,vw-is-output
  VWGPMS (Master-to-Slave, input,  Host->BIC): omit nuvoton,vw-is-output

compatible: "nuvoton,npcm4xx-vw-gpio"

include: [base.yaml]

properties:
  reg:
    type: array
    required: true
    description: Base address and total size covering all SM and MS bank registers.

  label:
    type: string
    required: true

child-binding:
  description: |
    One VW GPIO bank register (4 wires). Child nodes of nuvoton,npcm4xx-vw-gpio
    do not need a compatible property; their binding is inherited from here.

  include: [gpio-controller.yaml]

  properties:
    label:
      type: string
      required: true

    nuvoton,vw-is-output:
      type: boolean
      description: |
        Present when this bank is a VWGPSM (Slave-to-Master, output) register.
        Absent for VWGPMS (Master-to-Slave, input) registers.

    nuvoton,vw-bank-index:
      type: int
      required: true
      description: |
        Global bank index 0~31.
        0~15  = VWGPSM0~15 (Slave-to-Master, output, BIC->Host).
        16~31 = VWGPMS0~15 (Master-to-Slave, input,  Host->BIC).
        Register address = parent_base + bank_idx * 4.
```

## dts/bindings/interrupt-controller/nuvoton,npcm-miwu.yaml
```yaml
# Copyright (c) 2024 Nuvoton Technology Corporation.
# SPDX-License-Identifier: Apache-2.0

description: |
  Nuvoton NPCM Multi-Input Wake-Up (MIWU) module.

  A module has eight groups of eight wake-up inputs (WUI). Each group has its own edge, mode,
  pending, and enable registers and drives one NVIC line, named WKINTA through WKINTH in the
  datasheet. The NVIC line of a group belongs to the driver that owns all eight inputs:

  - A GPIO port owns its group and programs it directly through the port node's nuvoton,miwu
    and nuvoton,wui-group properties. Do not list that group's line here.
  - A group shared by several peripherals, such as the SMBus and RTC wake-ups on MIWU1 group 8,
    is serviced by the MIWU driver. List its NVIC line in interrupts with the datasheet output
    name, and let each peripheral name its input with a nuvoton,wui phandle:

      miwu1: miwu@400bd000 {
        interrupts = <55 3>;
        interrupt-names = "wkinth";
        #wui-cells = <2>;
      };

      rtc { nuvoton,wui = <&miwu1 8 7>; };   /* group 8, input 7 */

  - An input with its own NVIC line, such as the EMAC wake-up on MIWU1 group 5, is configured
    through the same phandle by the driver that connects that interrupt. Its group is not listed
    here.

compatible: "nuvoton,npcm-miwu"

include: base.yaml

properties:
  reg:
    required: true

  interrupts:
    description: NVIC lines of the groups the MIWU driver services, one per interrupt-names entry.

  interrupt-names:
    description: |
      Datasheet name of each line in interrupts, in lower case: wkinta for group 1 through
      wkinth for group 8.

  "#wui-cells":
    type: int
    required: true
    const: 2

wui-cells:
  - group
  - bit
```

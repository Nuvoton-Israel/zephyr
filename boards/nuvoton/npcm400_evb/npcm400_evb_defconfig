## dts/bindings/pinctrl/nuvoton,npcm-pinctrl.yaml
```yaml
# Copyright (c) 2024 Nuvoton Technology Corporation.
# SPDX-License-Identifier: Apache-2.0

description: |
  Nuvoton NPCM pin controller.

  The controller programs pin multiplexing, peripheral pull-up/down, and voltage-level bits in
  the System Configuration (SCFG) block through the nuvoton,scfg phandle. The
  nuvoton,npcm-pinfunc node describes the settings for every pin function for each SoC series.

  The children of this node are pin groups that peripherals reference through their pinctrl-N
  property. Each pin-group child configures one pin by selecting a function through a phandle.
  It can also enable the function's pull resistor, select its voltage level, or write an
  additional SCFG control bit.

  The SoC provides the groups for every peripheral port in npcm<n>-pinctrl.dtsi, marked
  /omit-if-no-ref/. A board only has to pick them and add per-pin settings.

  Example, I2C6B on GPIO16 (SCL) and GPIO17 (SDA), with a 1.8V pull-up on SDA:

    /* npcm4-pinctrl.dtsi, provided by the SoC */
    &pinctrl {
      /omit-if-no-ref/ i2c6b_scl_sda_gpio16_17: periph-i2c6b {
        scl {
          pinmux = <&pin_gpio16_scl6b>;
        };
        sda {
          pinmux = <&pin_gpio17_sda6b>;
        };
      };
    };

    /* board DTS */
    &i2c6b_scl_sda_gpio16_17 {
      sda {
        bias-pull-up;
        nuvoton,voltage-level-mv = <1800>;
      };
    };

    &i2c6b {
      pinctrl-0 = <&i2c6b_scl_sda_gpio16_17>;
      pinctrl-names = "default";
    };

  Reclaiming a pin for GPIO uses the same mechanism: every multiplexed pin has a
  pin_gpioNN_gpio function that a group can select.

compatible: "nuvoton,npcm-pinctrl"

include: base.yaml

properties:
  nuvoton,scfg:
    type: phandle
    required: true
    description: The System Configuration (SCFG) register block the controller writes.

child-binding:
  description: |
    A pin group. Peripherals reference it from pinctrl-N. Its children each configure one
    pin.

  child-binding:
    description: One pin of a group.

    include:
      - name: pincfg-node.yaml
        property-allowlist:
          - bias-disable
          - bias-pull-up
          - bias-pull-down

    properties:
      pinmux:
        type: phandle
        required: true
        description: The pin function to select, a child of the nuvoton,npcm-pinfunc node.

      bias-pull-up:
        description: |
          Enable the function's internal pull-up. The function must declare one with
          nuvoton,pull-up-reg; asking for the direction the hardware does not have fails
          with -ENOTSUP. Without a bias property the resistor is left as it is.

      bias-pull-down:
        description: |
          Enable the function's internal pull-down. The function must declare one with
          nuvoton,pull-down-reg.

      bias-disable:
        description: |
          Disable the function's internal pull resistor. Like the pull properties, this needs
          a function that declares one; otherwise it fails with -ENOTSUP.

      nuvoton,voltage-level-mv:
        type: int
        enum: [1800, 3300]
        description: |
          Signal voltage of the pin. Only functions with a nuvoton,low-voltage-reg can be set
          to 1800; others fail with -ENOTSUP.

          The low-voltage selects reset to 1.8 V, so a board running such a pin at 3.3 V must
          say so with <3300>; leaving the property out keeps the reset level. A pin used at
          1.8 V must have its internal pull disabled, which is the reset state of PxPULL.

      nuvoton,device-control:
        type: array
        description: |
          One extra SCFG bit to write with this pin, as <register bit value>, for per-port
          controls such as tri-state or write protect. Use one child node per bit.
```

## dts/bindings/pinctrl/nuvoton,npcm-pinfunc.yaml
```yaml
# Copyright (c) 2024 Nuvoton Technology Corporation.
# SPDX-License-Identifier: Apache-2.0

description: |
  Nuvoton NPCM pin function table.

  Pin multiplexing on NPCM is controlled by the System Configuration (SCFG) block. Each pin
  has a selection table whose DEVALTx bit values select one of its functions. For example,
  DEVALT7[6], DEVALTB[6], and DEVALT6D[7] select GPIO17 functions: 1xx selects CLKOUT, 01x
  selects RIA, 001 selects I2C6B_SDA, and 000 selects GPIO17. A function can also have a
  pull-up/down enable bit and a low-voltage select bit in SCFG.

  Every child of this node describes one row of a pin selection table: the SCFG bits that
  select a function and its pull and voltage controls. The SoC provides these nodes in
  npcm<n>-pinfunc.dtsi, one file per series; boards select them by phandle from a
  nuvoton,npcm-pinctrl node.

  Example, the GPIO17 rows above:

    &pinfunc {
      /omit-if-no-ref/ pin_gpio17_gpio: pin-gpio17-gpio {
        nuvoton,alts = <NPCM_SCFG_DEVALT6D 7 0>,
                       <NPCM_SCFG_DEVALTB 6 0>,
                       <NPCM_SCFG_DEVALT7 6 0>;
      };
      /omit-if-no-ref/ pin_gpio17_sda6b: pin-gpio17-sda6b {
        nuvoton,alts = <NPCM_SCFG_DEVALT6D 7 1>,
                       <NPCM_SCFG_DEVALTB 6 0>,
                       <NPCM_SCFG_DEVALT7 6 0>;
        nuvoton,pull-up-reg = <NPCM_SCFG_DEVPD1 4>;
        nuvoton,low-voltage-reg = <NPCM_SCFG_LV_CTL3 7>;
      };
    };

  Functions selected by a strap rather than by SCFG bits have no nuvoton,alts property.

compatible: "nuvoton,npcm-pinfunc"

include: base.yaml

child-binding:
  description: One selectable function of one pin.

  properties:
    nuvoton,alts:
      type: array
      description: |
        SCFG bits that select this function, as <register bit value> triplets. The register
        is an offset from the SCFG base, given with the NPCM_SCFG_* macros. Every bit of the
        pin's selection table is listed, including the ones that must be zero, so that
        writing the whole row selects exactly this function.

    nuvoton,pull-up-reg:
      type: array
      description: |
        <register bit> of the SCFG enable for this function's internal pull-up resistor.
        Present only on functions that have one. A pin configuration enables it with
        bias-pull-up.

    nuvoton,pull-down-reg:
      type: array
      description: |
        <register bit> of the SCFG enable for this function's internal pull-down resistor.
        Present only on functions that have one. A pin configuration enables it with
        bias-pull-down.

    nuvoton,low-voltage-reg:
      type: array
      description: |
        <register bit> of the SCFG low-voltage select for this function. Present only on
        functions that can run at 1.8V. A pin configuration picks the level with
        nuvoton,voltage-level-mv.
```

## dts/bindings/syscon/nuvoton,npcm-scfg.yaml
```yaml
# Copyright (c) 2024 Nuvoton Technology Corporation.
# SPDX-License-Identifier: Apache-2.0

description: |
  Nuvoton NPCM System Configuration (SCFG) register block.

  SCFG holds device-wide controls, including pin multiplexing (DEVALTx), some pull-up/down
  enables, low-voltage selects, reset state, and strap status. It is shared by drivers. The pin
  controller accesses SCFG through its nuvoton,scfg phandle; other drivers use their own
  phandles and the syscon API, avoiding dependencies between drivers.

  Registers are one byte wide, hence reg-io-width = <1>.

compatible: "nuvoton,npcm-scfg"

include: syscon.yaml
```

## dts/bindings/watchdog/nuvoton,npcm-watchdog.yaml
```yaml
# Copyright (c) 2024 Nuvoton Technology Corporation.
# SPDX-License-Identifier: Apache-2.0

description: Nuvoton, NPCM-TWD node

compatible: "nuvoton,npcm-watchdog"

include: [base.yaml]

properties:
  reg:
    required: true
  nuvoton,timer0-wui:
    type: array
    required: true
    description: |
        Mapping table between Wake-Up Input (WUI) and timer0 expired signal.

        For example the WUI mapping on NPCM4 t0-out timer would be:
          nuvoton,timer0-wui = <NPCM_MIWU1_GROUPE_T0OUT>;
```

## soc/nuvoton/npcm/npcm5/Kconfig
```kconfig
# Copyright (c) 2026 Nuvoton Technology Corporation.
#
# SPDX-License-Identifier: Apache-2.0

config SOC_SERIES_NPCM5
	select ARM
	select CPU_CORTEX_M7
	select CPU_CORTEX_M_HAS_DWT
	select CORTEX_M_SYSTICK
	select CPU_HAS_ARM_MPU
	select CPU_HAS_FPU
	select CPU_HAS_ICACHE
	select CPU_HAS_DCACHE
	select CLOCK_CONTROL
```

## soc/nuvoton/npcm/npcm5/Kconfig.defconfig
```kconfig
# Copyright (c) 2026 Nuvoton Technology Corporation.
#
# SPDX-License-Identifier: Apache-2.0

if SOC_SERIES_NPCM5

config NUM_IRQS
	default 82

endif # SOC_SERIES_NPCM5
```

## soc/nuvoton/npcm/npcm5/Kconfig.soc
```kconfig
# Copyright (c) 2026 Nuvoton Technology Corporation.
#
# SPDX-License-Identifier: Apache-2.0

config SOC_SERIES_NPCM5
	bool
	select SOC_FAMILY_NPCM
	help
	  Enable support for Nuvoton NPCM5 series

config SOC_NPCM500
	bool
	select SOC_SERIES_NPCM5

config SOC_SERIES
	default "npcm5" if SOC_SERIES_NPCM5

config SOC
	default "npcm500" if SOC_NPCM500
```

## subsys/usb/class/Kconfig.obmf
```kconfig
# Copyright (c) 2025 Google LLC
# SPDX-License-Identifier: Apache-2.0

menuconfig USB_DEVICE_OBMF
	bool "USB OCP OBMF Class support"
	help
	  USB OCP OBMF device class support.

if USB_DEVICE_OBMF

config USB_OBMF_DEVICE_NAME
	string "USB OBMF device name template"
	default "OBMF"
	help
	  Device name template for the OBMF Devices. First device would have
	  name $(USB_OBMF_DEVICE_NAME)_0, etc.

module = USB_OBMF
default-count = 1
source "subsys/usb/class/Kconfig.template.composite_device_number"

config OBMF_BULK_EP_MPS
	int "OBMF bulk endpoint size"
	default 512 if USB_DC_HAS_HS_SUPPORT
	default 64
	help
	  OBMF class bulk endpoints size.

config OBMF_INTERRUPT_IN_EP_SUPPORT
	bool "Enable OBMF Interrupt IN endpoint"
	default y
	help
	  Enable support for the optional Interrupt IN endpoint
	  (Device -> Host notification/event).

config OBMF_INTERRUPT_IN_EP_MPS
	int "OBMF Interrupt IN endpoint size"
	default 16
	depends on OBMF_INTERRUPT_IN_EP_SUPPORT
	help
	  OBMF class Interrupt IN endpoint max packet size.
	  Recommended <= 64 bytes.

config OBMF_INTERRUPT_OUT_EP_SUPPORT
	bool "Enable OBMF Interrupt OUT endpoint"
	default n
	help
	  Enable support for the optional Interrupt OUT endpoint
	  (Host -> Device notification/event).

config OBMF_INTERRUPT_OUT_EP_MPS
	int "OBMF Interrupt OUT endpoint size"
	default 16
	depends on OBMF_INTERRUPT_OUT_EP_SUPPORT
	help
	  OBMF class Interrupt OUT endpoint max packet size.
	  Recommended <= 64 bytes.

module = USB_OBMF
module-str = usb obmf
source "subsys/logging/Kconfig.template.log_config"

endif # USB_DEVICE_OBMF
```

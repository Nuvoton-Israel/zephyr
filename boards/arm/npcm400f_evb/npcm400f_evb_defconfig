## boards/arm/npcm400f_evb/npcm400f_evb_defconfig
```kconfig
#
# Copyright (c) 2023 Nuvoton Technology Corporation.
#
# SPDX-License-Identifier: Apache-2.0
#

CONFIG_SOC_NPCM400F=y
CONFIG_SOC_SERIES_NPCM400F=y
CONFIG_BOARD_NPCM400F_EVB=y

CONFIG_SRAM_VECTOR_TABLE=y
# General Kernel Options
CONFIG_SYS_CLOCK_HW_CYCLES_PER_SEC=96000000
CONFIG_XIP=n
CONFIG_BOOTLOADER_SRAM_SIZE=0
CONFIG_MAIN_STACK_SIZE=4096
CONFIG_HEAP_MEM_POOL_SIZE=16384

# Clock Driver
CONFIG_CLOCK_CONTROL=y
CONFIG_CLOCK_CONTROL_NPCM4XX=y

# UART Driver
CONFIG_SERIAL=y
CONFIG_UART_INTERRUPT_DRIVEN=y
CONFIG_UART_NPCM4XX=y

# Pinmux Driver
CONFIG_PINMUX=y
CONFIG_PINMUX_NPCM4XX=y
CONFIG_PINCTRL_STRING_NAME=y

# GPIO Driver
CONFIG_GPIO=y
CONFIG_GPIO_NPCM4XX=y

# Console Driver
CONFIG_CONSOLE=y
CONFIG_UART_CONSOLE=y

# Watchdog Driver
CONFIG_WATCHDOG=y
CONFIG_WDT_NPCM4XX=y

# MIWU Driver
CONFIG_NPCM4XX_MIWU=y

# PECI driver
# CONFIG_PECI=y
# CONFIG_PECI_NPCM4XX=y

#Counter Driver
CONFIG_COUNTER=y
CONFIG_COUNTER_NPCM4XX=y

# SPIM Driver
CONFIG_FLASH=y
CONFIG_SPI=y
CONFIG_SPI_NOR_MULTI_DEV=y
CONFIG_SPI_NPCM4XX_SPIM=y

# FIU Driver
CONFIG_FLASH=y
CONFIG_SPI=y
CONFIG_SPI_NOR_MULTI_DEV=y
CONFIG_SPI_NPCM4XX_FIU=y

# ESPI Driver
CONFIG_ESPI=y

# IPMI Driver
CONFIG_IPMI=y
CONFIG_IPMI_KCS_NPCM4XX=y

# I2C Driver
CONFIG_I2C_NPCM4XX=y
CONFIG_I2C=y

# I3C driver
CONFIG_I3C=y
CONFIG_I3C_NPCM4XX=y

#ADC Driver
CONFIG_ADC=y
CONFIG_ADC_NPCM4XX=y

#SPIP Driver
CONFIG_SPI=y
CONFIG_SPIP_NPCM4XX=y

# I3C driver
CONFIG_I3C=y
CONFIG_I3C_NPCM4XX=y
CONFIG_I3C_SLAVE=y
CONFIG_I3C_SLAVE_MQUEUE=y

# USB Driver
CONFIG_USB=y
CONFIG_USB_DC_NPCM4XX=y

# JTAG Driver
CONFIG_JTAG=n
CONFIG_JTAG_SHELL=n
CONFIG_JTAG_NPCM4XX=n

# SGPIO Driver
CONFIG_SGPIO_NPCM4XX=n

# EMAC Driver
CONFIG_ETH_NPCM4XX=y

# Networking config
CONFIG_NETWORKING=y
CONFIG_NET_L2_ETHERNET=y
CONFIG_NET_IPV4=y
CONFIG_NET_IPV6=n
CONFIG_NET_TCP=y
CONFIG_NET_SOCKETS=y
CONFIG_NET_SHELL=y
CONFIG_NET_TCP_ISN_RFC6528=n
CONFIG_NET_CONFIG_SETTINGS=y
CONFIG_NET_CONFIG_AUTO_INIT=y
CONFIG_NET_CONFIG_NEED_IPV4=y
CONFIG_NET_CONFIG_MY_IPV4_ADDR="192.0.2.1"
CONFIG_NET_CONFIG_PEER_IPV4_ADDR="192.0.2.2"
CONFIG_NET_CONFIG_INIT_TIMEOUT=3

# Network driver config
CONFIG_TEST_RANDOM_GENERATOR=y
```

## boards/arm64/npcm8xx_evb/Kconfig.board
```kconfig
# Copyright 2023 Nuvoton
# SPDX-License-Identifier: Apache-2.0

config BOARD_NPCM8XX_EVB
	bool "NUVOTON NPCM8XX EVB"
	select ARM64
```

## boards/arm64/npcm8xx_evb/Kconfig.defconfig
```kconfig
# Copyright 2023 Nuvoton
# SPDX-License-Identifier: Apache-2.0

if BOARD_NPCM8XX_EVB

config BOARD
	default "npcm8xx_evb"

endif # BOARD_NPCM8XX_EVB
```

## boards/arm64/npcm8xx_evb/npcm8xx_evb_defconfig
```kconfig
# SPDX-License-Identifier: Apache-2.0

# ARM Options
CONFIG_AARCH64_IMAGE_HEADER=y
CONFIG_ARMV8_A_NS=y
CONFIG_ARM_ARCH_TIMER=y

# Cache Options
CONFIG_CACHE_MANAGEMENT=y

# Platform Configuration
CONFIG_SOC_NUVOTON_NPCM8XX=y
CONFIG_BOARD_NPCM8XX_EVB=y

# Zephyr Kernel Configuration
CONFIG_XIP=y

# SMP
CONFIG_SMP=n

# Serial Drivers
CONFIG_SERIAL=y
CONFIG_UART_INTERRUPT_DRIVEN=y
CONFIG_UART_NS16550=y

# Enable Console
CONFIG_CONSOLE=y
CONFIG_UART_CONSOLE=y

CONFIG_MAX_XLAT_TABLES=10
```

## drivers/adc/Kconfig.npcm4xx
```kconfig
# NPCM4XX ADC driver configuration options

# Copyright (c) 2020 Nuvoton Technology Corporation.
# SPDX-License-Identifier: Apache-2.0

config ADC_NPCM4XX
	bool "Nuvoton NPCM4XX ADC driver"
	depends on SOC_FAMILY_NPCM4XX
	help
	  This option enables the ADC driver for NPCM4XX family of
	  processors.
	  Say y if you wish to use ADC channels on NPCM4XX MCU.
```

## drivers/clock_control/Kconfig.npcm4xx
```kconfig
# NPCM4XX Clock controller driver configuration options

# Copyright (c) 2023 Nuvoton Technology Corporation.
# SPDX-License-Identifier: Apache-2.0

config CLOCK_CONTROL_NPCM4XX
	bool "NPCM4XX clock controller driver"
	depends on SOC_FAMILY_NPCM4XX
	help
	  Enable support for NPCM4XX clock controller driver.
```

## drivers/counter/Kconfig.npcm4xx
```kconfig
# Counter driver for x86 "CMOS" clock

# Copyright (c) 2019 Intel Corp.
# SPDX-License-Identifier: Apache-2.0

config COUNTER_NPCM4XX
	bool "Counter driver for NPCM4XX timer"
	default "y"
```

## drivers/espi/Kconfig.npcm4xx
```kconfig
# NPCM4XX eSPI driver configuration options

# Copyright (c) 2020 Nuvoton Technology Corporation.
# SPDX-License-Identifier: Apache-2.0

config ESPI_NPCM4XX
	bool "Nuvoton NPCM4XX ESPI driver"
	depends on SOC_FAMILY_NPCM4XX
	help
	  This option enables the Intel Enhanced Serial Peripheral Interface
	  (eSPI) for NPCM4XX family of processors.

# The default value 'y' for the existing options if ESPI_NPCM4XX is selected.
if ESPI_NPCM4XX

config ESPI_OOB_CHANNEL
	default  y

config ESPI_PERIPHERAL_8042_KBC
	default n

config ESPI_PERIPHERAL_HOST_IO
	default y

config ESPI_PERIPHERAL_DEBUG_PORT_80
	default n

endif #ESPI_NPCM4XX
```

## drivers/ethernet/Kconfig.npcm4xx
```kconfig
# Nuvoton Ethernet driver configuration options

# SPDX-License-Identifier: Apache-2.0

DT_COMPAT_NUVOTON_NPCM4XX_ETHERNET := nuvoton,npcm4xx-ethernet

config ETH_NPCM4XX
	bool "Nuvoton NPCM4XX Ethernet driver"
	depends on SOC_FAMILY_NPCM4XX
	help
	  This option enables the ethernet driver for NPCM4XX family of
	  processors.
	  Say y if you wish to use ethernet on NPCM4XX MCU.

config ETH_NPCM4XX_RX_THREAD_STACK_SIZE
	int "RX thread stack size"
	default 4096
	help
	  RX thread stack size

config ETH_NPCM4XX_RX_THREAD_PRIO
	int "RX thread priority"
	default 3
	help
	  RX thread priority

config ETH_NPCM4XX_PHY_ADDRESS
	int "Phy address"
	default 1
	help
	  The phy address to use.

config ETH_NPCM4XX_RANDOM_MAC
	bool "Random MAC address"
	depends on ENTROPY_GENERATOR
	default y
	help
	  Generate a random MAC address dynamically.

if !ETH_NPCM4XX_RANDOM_MAC

config ETH_NPCM4XX_MAC3
	hex "MAC Address Byte 3"
	default 0
	range 0 0xff
	help
	  This is the byte 3 of the MAC address.

config ETH_NPCM4XX_MAC4
	hex "MAC Address Byte 4"
	default 0
	range 0 0xff
	help
	  This is the byte 4 of the MAC address.

config ETH_NPCM4XX_MAC5
	hex "MAC Address Byte 5"
	default 0
	range 0 0xff
	help
	  This is the byte 5 of the MAC address.

endif # !ETH_NPCM4XX_RANDOM_MAC

config ETH_NPCM4XX_CARRIER_CHECK_RX_IDLE_TIMEOUT_MS
	int "Carrier check timeout period (ms)"
	default 500
	range 100 30000
	help
	  Set the RX idle timeout period in milliseconds after which the
	  PHY's carrier status is re-evaluated.
```

## drivers/gpio/Kconfig.npcm4xx
```kconfig
# NPCM4XX GPIO driver configuration options

# Copyright (c) 2023 Nuvoton Technology Corporation.
# SPDX-License-Identifier: Apache-2.0

config GPIO_NPCM4XX
	bool "Nuvoton NPCM4XX gpio driver"
	depends on SOC_FAMILY_NPCM4XX
	help
	  This option enables the GPIO driver for NPCM4XX family of
	  processors.
	  Say y if you wish to use GPIO on NPCM4XX MCU.

config SGPIO_NPCM4XX
	bool "Nuvoton NPCM4XX sgpio driver"
	depends on SOC_FAMILY_NPCM4XX
	help
	  This option enables the SGPIO driver for NPCM4XX family of
	  processors.
	  Say y if you wish to use SGPIO on NPCM4XX MCU.

config GPIO_NPCM4XX_SGPIO_INIT_PRIORITY
	int "Init priority"
	depends on SGPIO_NPCM4XX
	default 60
	help
	  Device driver initialization priority.
```

## drivers/i2c/Kconfig.npcm4xx
```kconfig
# NPCM4XX I2C driver configuration options

# Copyright (c) 2020 Nuvoton Technology Corporation.
# SPDX-License-Identifier: Apache-2.0

config I2C_NPCM4XX
	bool "Nuvoton NPCM4XX I2C driver"
	depends on SOC_FAMILY_NPCM4XX
	help
	  This option enables the I2C driver for NPCM4xx
	  family of processors.
	  Say y to use I2C modules on NPCM4XX MCU.
```

## drivers/i3c/Kconfig.npcm4xx
```kconfig
# NPCM4XX I3C driver configuration options

# Copyright (c) 2023 Nuvoton Technology Corporation.
# SPDX-License-Identifier: Apache-2.0

config I3C_NPCM4XX
	bool "NPCM4XX I3C driver"
	depends on SOC_FAMILY_NPCM4XX
	help
	  This option enables the I3C master driver for SOC_NPCM400F SoCs.
```

## drivers/interrupt_controller/Kconfig.npcm4xx
```kconfig
# NPCM4XX GPIO driver configuration options

# Copyright (c) 2020 Nuvoton Technology Corporation.
# SPDX-License-Identifier: Apache-2.0

config NPCM4XX_MIWU
	bool "Nuvoton NPCM4XX embedded controller (EC) miwu driver"
	default y
	depends on SOC_FAMILY_NPCM4XX
	help
	  This option enables the Multi-Input Wake-Up Unit (MIWU) driver
	  for NPCM4XX family ofprocessors.
	  This is required for GPIO, RTC, LPC/eSPI interrupt support.
```

## drivers/ipmi/Kconfig
```kconfig
# SPDX-License-Identifier: Apache-2.0
#
# Copyright (c) 2021 Nuvoton Technology Corporation.

menuconfig IPMI
	bool "IPMI Driver"
	help
	  Enable IPMI Driver.

if IPMI

source "drivers/ipmi/Kconfig.npcm4xx"

endif # IPMI
```

## drivers/ipmi/Kconfig.npcm4xx
```kconfig
# Nuvoton IPMI driver configuration options

# Copyright (c) 2021 Nuvoton Technology Corporation.
# SPDX-License-Identifier: Apache-2.0

config IPMI_KCS_NPCM4XX
	bool "NPCM4XX IPMI KCS driver"
	depends on SOC_FAMILY_NPCM4XX
	help
	  This option enables the KCS BMC driver for NPCM4XX
	  SoCs.
	  Say y if you wish to use KCS channels on NPCM4XX MCU.
```

## drivers/misc/npcm/Kconfig
```kconfig
# NPCM misc. driver options

# Copyright (c) 2024 Nuvoton
# SPDX-License-Identifier: Apache-2.0

config SNOOP_NPCM
	bool "NPCM SNOOP driver"
	depends on SOC_FAMILY_NPCM4XX
	help
	  This option enables the snoop driver for NPCM
	  SoCs.
	  Say y if you wish to use P80 data byte snooping
	  on NPCM SMC.
```

## drivers/peci/Kconfig.npcm4xx
```kconfig
# NPCM4XX PECI driver configuration options

# Copyright (c) 2022 Nuvoton Technology Corporation.
# SPDX-License-Identifier: Apache-2.0

config PECI_NPCM4XX
	bool "NPCM4XX PECI driver"
	default y
	depends on SOC_FAMILY_NPCM4XX
	select PECI_INTERRUPT_DRIVEN
	help
	  Enable the NPCM4XX PECI IO driver.
```

## drivers/pinmux/Kconfig.npcm4xx
```kconfig
# PINMUX configuration options for NPCM4XX SOC

# Copyright (c) 2023 Nuvoton Technology Inc.
# SPDX-License-Identifier: Apache-2.0

menuconfig PINMUX_NPCM4XX
	bool "NPCM4XX SOC pinmux driver"
	depends on SOC_FAMILY_NPCM4XX
	help
	  Enable driver for the NPCM4XX SOC pinmux driver

config PINCTRL_STRING_NAME
	bool "Debug: print pin/signal with string name"
	depends on PINMUX_NPCM4XX
	help
	  Create pin/signal string table for debug
```

## drivers/serial/Kconfig.npcm4xx
```kconfig
# Copyright (c) 2021 Nuvoton Technology Corporation.
#
# SPDX-License-Identifier: Apache-2.0

config UART_NPCM4XX
	bool "NUVOTON NPCM4XX serial driver"
	select SERIAL_HAS_DRIVER
	depends on SOC_FAMILY_NPCM4XX
	help
	  This option enables the UART driver for Nuvoton NPCM4XX
	  family of processors.
	  Say y to use serial port on Nuvoton MCU.
```

## drivers/spi/Kconfig.npcm4xx_spip
```kconfig
# NPCM4XX SPI Driver configuration options

# Copyright (c) 2023 Nuvoton Technology Corporation.
# SPDX-License-Identifier: Apache-2.0

config SPIP_NPCM4XX
	bool "Nuvoton NPCM4XX SPI driver SPIP"
	default y
	depends on SOC_FAMILY_NPCM4XX
	help
	  Enable the SPI driver for NPCM4XX family of processors.
```

## drivers/watchdog/Kconfig.npcm4xx
```kconfig
# NPCM4XX WDT driver configuration options

# Copyright (c) 2023 Nuvoton Technology Corporation.
# SPDX-License-Identifier: Apache-2.0

config WDT_NPCM4XX
	bool "Nuvoton NPCM4XX Watchdog Timer driver"
	depends on SOC_FAMILY_NPCM4XX
	help
	  This option enables the Watchdog Timer driver for NPCM4XX family of
	  processors.
	  Say y if you wish to use watchdog on NPCM4XX MCU.

config WDT_NPCM4XX_DELAY_CYCLES
	int "Number of delay cycles before generating watchdog event/signal"
	depends on WDT_NPCM4XX
	range 1 255
	default 5
	help
	  This option defines the window in which a watchdog event must be handled.
	  If the watchdog timeout value is under 1 second, the WDT_NPCM4XX_DELAY_CYCLES unit is 31 ms.
	  If the watchdog timeout value is under 1 minute, the WDT_NPCM4XX_DELAY_CYCLES unit is 250 ms.
	  Otherwise, the WDT_NPCM4XX_DELAY_CYCLES unit is 8 second.
	  After this time window, the watchdog reset triggers immediately.
```

## dts/bindings/adc/nuvoton,npcm4xx-adc.yaml
```yaml
# Copyright (c) 2020 Nuvoton Technology Corporation.
# SPDX-License-Identifier: Apache-2.0

description: Nuvoton, NPCM4XX-ADC node

compatible: "nuvoton,npcm4xx-adc"

include: [adc-controller.yaml, nuvoton-pinctrl.yaml]

properties:
    reg:
        required: true
    clocks:
        required: true
    label:
        required: true
    pinctrl-0:
        type: phandles
        required: true
        description: configurations of pinmux controllers

io-channel-cells:
    - input
```

## dts/bindings/espi/nuvoton,npcm4xx-espi.yaml
```yaml
# Copyright (c) 2020 Nuvoton Technology Corporation.
# SPDX-License-Identifier: Apache-2.0

description: Nuvoton, NPCM4XX-eSPI node

compatible: "nuvoton,npcm4xx-espi"

include: [espi-controller.yaml, nuvoton-pinctrl.yaml]

properties:
    reg:
      description: mmio register space
      required: true

    clocks:
        required: true
        description: configurations of device source clock controller

    espi-rst-wui:
        type: phandle
        required: true
        description: |
            Mapping table between Wake-Up Input (WUI) and ESPI_RST signal.

            For example the WUI mapping on NPCM4XX would be
               espi-rst-wui = <&wui_espi_rst>;
```

## dts/bindings/ethernet/nuvoton,npcm4xx-ethernet.yaml
```yaml
# Copyright (c) 2024 Nuvoton Technology Corporation.
# SPDX-License-Identifier: Apache-2.0

description: NUVOTON NPCM4XX Ethernet

compatible: "nuvoton,npcm4xx-ethernet"

include: ["ethernet.yaml", "nuvoton-pinctrl.yaml"]

properties:
    reg:
      required: true
    interrupts:
      required: true
    pinctrl-0:
        type: phandles
        required: true
        description: configurations of pinmux controllers
```

## dts/bindings/gpio/nuvoton,npcm4xx-gpio.yaml
```yaml
# Copyright (c) 2023 Nuvoton Technology Corporation.
# SPDX-License-Identifier: Apache-2.0

description: Nuvoton, NPCM4XX-GPIO node

compatible: "nuvoton,npcm4xx-gpio"

include: [gpio-controller.yaml, base.yaml]

properties:
    reg:
        required: true

    label:
        required: true

    index:
        type: int
        required: true
        description: index of gpio device

    pin-offset:
        type: int
        required: true
        description: Pin offset of this GPIO entry

    wui-maps:
        type: phandles
        required: true
        description: |
            Mapping table between Wake-Up Input (WUI) and 8 IOs belong to this device.
            Please notice not all IOs connect to WUIs.
            In this case, it will be presented by wui_none.

            For example the WUI mapping on NPCM4XX GPIO8 would be
               wui-maps = <&wui_io80 &wui_io81 &wui_io82 &wui_io83
                           &wui_none &wui_none &wui_io86 &wui_io87>;

    "#gpio-cells":
      const: 2

gpio-cells:
  - pin
  - flags
```
